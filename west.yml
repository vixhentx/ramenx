## west.yml
```yaml
manifest:
  version: "1.2"

  projects:
    - name: zephyr
      url: https://github.com/zephyrproject-rtos/zephyr
      revision: main
      path: modules/zephyr
      west-commands: scripts/west-commands.yml

  self:
    path: .
```

## zephyr/Kconfig
```kconfig
menuconfig RAMENX
	bool "ramen extensions"
	default y
	help
	  Enable ramen operators and Zephyr scheduling integration.
```
